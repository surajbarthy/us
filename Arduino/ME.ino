//21301
//Arduino 1 OR 3
/*********************************************************************
  This is an example for our Monochrome OLEDs based on SH110X drivers

  This example is for a 128x64 size display using I2C to communicate
  3 pins are required to interface (2 I2C and one reset)

  Adafruit invests time and resources providing this open source code,
  please support Adafruit and open-source hardware by purchasing
  products from Adafruit!

  Written by Limor Fried/Ladyada  for Adafruit Industries.
  BSD license, check license.txt for more information
  All text above, and the splash screen must be included in any redistribution

  i2c SH1106 modified by Rupert Hirst  12/09/21
*********************************************************************/

//Arduino MQTT Display


#include <SPI.h>
#include <Wire.h>
#include <Adafruit_GFX.h>
#include <Adafruit_SH110X.h>

#include <WiFiNINA.h>
#include <ArduinoMqttClient.h>

/* Uncomment the initialize the I2C address , uncomment only one, If you get a totally blank screen try the other*/
#define i2c_Address 0x3c //initialize with the I2C addr 0x3C Typically eBay OLED's
//#define i2c_Address 0x3d //initialize with the I2C addr 0x3D Typically Adafruit OLED's

#define SCREEN_WIDTH 128 // OLED display width, in pixels
#define SCREEN_HEIGHT 64 // OLED display height, in pixels
#define OLED_RESET -1   //   QT-PY / XIAO
Adafruit_SH1106G display = Adafruit_SH1106G(SCREEN_WIDTH, SCREEN_HEIGHT, &Wire, OLED_RESET);


#define NUMFLAKES 10
#define XPOS 0
#define YPOS 1
#define DELTAY 2


#define LOGO16_GLCD_HEIGHT 16
#define LOGO16_GLCD_WIDTH  16
static const unsigned char PROGMEM logo16_glcd_bmp[] =
{ B00000000, B11000000,
  B00000001, B11000000,
  B00000001, B11000000,
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  B00000000, B00110000
};


// 'Me_Awake', 128x64px
const unsigned char meAwakeMe_Awake [] PROGMEM = {
  0x00, 0x00, 0x00, 0x00, 0x00, 0x00, 0x00, 0x00, 0x00, 0x00, 0x00, 0x00, 0x00, 0x00, 0x00, 0x00,
  0x00, 0x00, 0x00, 0x00, 0x00, 0x00, 0x00, 0x00, 0x00, 0x00, 0x00, 0x00, 0x00, 0x00, 0x00, 0x00,
  0x00, 0x00, 0x00, 0x00, 0x00, 0x00, 0x00, 0x00, 0x00, 0x00, 0x00, 0x00, 0x00, 0x00, 0x00, 0x00,
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  0x00, 0x00, 0x00, 0x00, 0x00, 0x00, 0x00, 0x00, 0x00, 0x00, 0x00, 0x00, 0x00, 0x00, 0x00, 0x00
};

// Array of all bitmaps for convenience. (Total bytes used to store images in PROGMEM = 1040)
const int meAwakeallArray_LEN = 1;
const unsigned char* meAwakeallArray[1] = {
  meAwakeMe_Awake
};




// 'Me_Sleep', 128x64px
const unsigned char meSleepMe_Sleep [] PROGMEM = {
  0x00, 0x00, 0x00, 0x00, 0x00, 0x00, 0x00, 0x00, 0x00, 0x00, 0x00, 0x00, 0x00, 0x00, 0x00, 0x00, 
  0x00, 0x00, 0x00, 0x00, 0x00, 0x00, 0x00, 0x00, 0x00, 0x00, 0x00, 0x00, 0x00, 0x00, 0x00, 0x00, 
  0x00, 0x00, 0x00, 0x00, 0x00, 0x00, 0x00, 0x00, 0x00, 0x00, 0x00, 0x00, 0x00, 0x00, 0x00, 0x00, 
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  0x00, 0x00, 0x00, 0x00, 0x00, 0x00, 0x00, 0x00, 0x00, 0x00, 0x00, 0x00, 0x00, 0x00, 0x00, 0x00
};

// Array of all bitmaps for convenience. (Total bytes used to store images in PROGMEM = 1040)
const int meSleepallArray_LEN = 1;
const unsigned char* meSleepallArray[1] = {
  meSleepMe_Sleep
};


#define ledpin 2
const int buttonPin = 12;
int buttonState = 0;
float numFloat = 0.0;
int numInt = 0;
float numFloat_notconv = 0.0;

String numString = "";

WiFiClient net;
MqttClient mqtt(net);

//const char wifiSSID[] = "sandbox370";
//const char wifiPass[] = "+s0a+s03!2gether?";

const char wifiSSID[] = "NYCR24";
const char wifiPass[] = "clubmate";

//  const char broker[] = "public.cloud.shiftr.io";
//  const int port = 1883;
//
//  const char mqttUser[] = "public";
//  const char mqttPass[] = "public";
//
//const char broker[] = "theyonetwork.cloud.shiftr.io";
//const int port = 1883;
//
//const char mqttUser[] = "theyonetwork";
//const char mqttPass[] = "hereismysecret";

const char broker[] = "suraj.cloud.shiftr.io";
const int port = 1883;

const char mqttUser[] = "suraj";
const char mqttPass[] = "keepingsecretsishard";


void setup()   {
  pinMode(LED_BUILTIN, OUTPUT);
  pinMode(ledpin, OUTPUT);
  Serial.begin(9600);
  pinMode(buttonPin, INPUT);

  // Show image buffer on the display hardware.
  // Since the buffer is intialized with an Adafruit splashscreen
  // internally, this will display the splashscreen.

  delay(250); // wait for the OLED to power up
  display.begin(i2c_Address, true); // Address 0x3C default
  //display.setContrast (0); // dim display

  display.display();
  delay(2000);

  // Clear the buffer.
  display.clearDisplay();


  //MQTT

  WiFi.begin(wifiSSID, wifiPass);

  while (WiFi.status() != WL_CONNECTED) {
    Serial.print (".");
    WiFi.begin(wifiSSID, wifiPass);
    delay(2000);
  }
  Serial.println("WiFi connected.");

  mqtt.setUsernamePassword(mqttUser, mqttPass);
  mqtt.setId("Arduino1_ME");
  while (!mqtt.connect(broker, port)) {
    Serial.print(".");
    delay(2000);
  }
  Serial.println("MQTT connected.");
  digitalWrite(LED_BUILTIN, HIGH);
  mqtt.subscribe("/test2");

  mqtt.subscribe("/test2/confirmation");
}


void loop() {
  float x;

  buttonState = digitalRead(buttonPin);
  if (buttonState == HIGH)
    x = 1;
  else
    x = 0;
  mqtt.beginMessage("/test1");
  mqtt.print(x);
  Serial.println(x);
  mqtt.endMessage();
  unsigned long sendTime = millis();

  bool confirmationReceived = false;
  //    y = mqtt.parseFloat();
  while (millis() < sendTime + 1000) {
    if (mqtt.parseMessage()) {
      //        if (mqtt.messageTopic() == "/test/confirmation")
      if (mqtt.messageTopic() == "/test2/confirmation")
      { confirmationReceived = true;
        //          if(mqtt.parseFloat() == 1)
        //          y=1;
        //          else
        //         y=0;
      }
    }
  }


  if (confirmationReceived) {
    Serial.println("got it!");
    digitalWrite(ledpin, HIGH);
  }
  else {
    Serial.println("didn't.");
    digitalWrite(ledpin, LOW);
  }
  //    if(y=1) digitalWrite(ledpin, HIGH);
  //    else digitalWrite(ledpin, LOW);
  //    Serial.println(y);
  delay(2000);


  int messageSize = mqtt.parseMessage();
  if (messageSize) {
    // we received a message, print out the topic and contents
    Serial.print("Received a message with topic: ");
    Serial.println(mqtt.messageTopic());
    numFloat = mqtt.parseFloat();
    Serial.println(numFloat);
    //    numInt = mqtt.parseInt();
    //    Serial.println(numInt);
    //    Serial.println(mqtt.readString());


    if (numFloat == 0)
    {
      //  Sleep
      digitalWrite(ledpin, HIGH);
      display.drawBitmap(0, 0, meSleepMe_Sleep, 128, 64, SH110X_WHITE);
      display.display();
      delay(2000);
      display.clearDisplay();
      //  mqtt.beginMessage("/test2/confirmation");
      //  mqtt.print("0");
      //  mqtt.endMessage();
      //  delay(1000);
    }           // wait for a second
    else
    {
      //  Awake
      //      digitalWrite(ledpin, HIGH);
      display.drawBitmap(0, 0, meAwakeMe_Awake, 128, 64, SH110X_WHITE);
      display.display();
      delay(2000);
      display.clearDisplay();
      //      mqtt.beginMessage("//confirmation");
      //    mqtt.print("1");
      //    mqtt.endMessage();

      //  delay(1000);
    }                      // wait for a second}

//    mqtt.beginMessage("/test1/confirmation");
//    mqtt.print("got it.");
//    mqtt.endMessage();
  }
}
